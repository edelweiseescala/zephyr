## drivers/sensor/adi/admt4000/Kconfig
```kconfig
# Copyright (c) 2026 Analog Devices, Inc.
#
# SPDX-License-Identifier: Apache-2.0

config ADMT4000
	bool "ADMT4000 True Power-On Multiturn Sensor"
	default y
	depends on DT_HAS_ADI_ADMT4000_ENABLED
	select SPI
	select RTIO_WORKQ if SENSOR_ASYNC_API
	help
	  Enable SPI-based driver for Analog Devices ADMT4000 True Power-On
	  Multiturn Sensor.

config ADMT4000_IIO
	bool "ADMT4000 IIO wrapper"
	default y
	depends on DT_HAS_ADI_ADMT4000_IIO_ENABLED
	depends on ZEPHYR_LIBIIO_MODULE
	depends on LIBIIO_IIO_DEVICE
	select ADMT4000
	help
	  Expose the ADMT4000 sensor to the libiio IIOD server as an IIO
	  device, publishing the turn count, angle, temperature, CORDIC
	  sine/cosine and signal radius channels along with the device
	  configuration attributes.

config ADMT4000_IIO_INIT_PRIORITY
	int "ADMT4000 IIO wrapper init priority"
	default 91
	depends on ADMT4000_IIO
	help
	  Initialization priority of the ADMT4000 IIO wrapper. This must be
	  numerically higher than SENSOR_INIT_PRIORITY (default 90) so that
	  the backing ADMT4000 sensor device is initialized first; the
	  wrapper checks device_is_ready() on it at init. If you raise
	  SENSOR_INIT_PRIORITY, raise this value to match.
```

## dts/bindings/sensor/adi,admt4000-iio.yaml
```yaml
# Copyright (c) 2026 Analog Devices, Inc.
#
# SPDX-License-Identifier: Apache-2.0

description: |
  IIO wrapper for the ADMT4000 True Power-On Multiturn Sensor.

  Exposes an "adi,admt4000" sensor device to the libiio IIOD server as an IIO
  device. The wrapper publishes the ADMT4000 turn count, angle, temperature,
  CORDIC sine/cosine and signal radius channels, plus the device
  configuration attributes, mirroring the no-OS ADMT4000 IIO driver.

  This node must be placed inside the "iio-context" node so that the Zephyr
  libiio backend picks it up when it builds the IIO context.

  Example:

    #include <zephyr/dt-bindings/gpio/arduino-header-r3.h>

    &arduino_spi {
            status = "okay";
            cs-gpios = <&arduino_header ARDUINO_HEADER_R3_D10 GPIO_ACTIVE_LOW>;

            admt4000: admt4000@0 {
                    compatible = "adi,admt4000";
                    reg = <0>;
                    spi-max-frequency = <2000000>;
                    adi,vdd-variant = <0>;
            };
    };

    / {
            iio-context {
                    admt4000_iio {
                            compatible = "adi,admt4000-iio";
                            io-name = "admt4000";
                            sensor-device = <&admt4000>;
                    };
            };
    };

compatible: "adi,admt4000-iio"

include: iio,iio-device.yaml

properties:
  sensor-device:
    type: phandle
    required: true
    description: |
      Phandle to the "adi,admt4000" sensor node that this IIO device exposes.
```
